## samples/nrf9160/lwm2m_demo/src/ipso/Kconfig
```kconfig
menu "LWM2M IPSO app"

config LWM2M_IPSO_APP_BUZZER
    bool "Enable IPSO Buzzer support"
    help
        This IPSO object is used to actuate an audible alarm such as a buzzer,
	    beeper, or vibration alarm.

if LWM2M_IPSO_APP_BUZZER
config LWM2M_IPSO_APP_BUZZER_INSTANCE_COUNT
    int "Maximum # of buzzer object instances"
	default 1
	depends on LWM2M_IPSO_APP_BUZZER
	help
        Total count of IPSO Buzzer instances
        available to the LWM2M client.
endif # LWM2M_IPSO_APP_BUZZER


config LWM2M_IPSO_APP_COLOUR_SENSOR
    bool "Enable IPSO Colour sensor support"
    help
        This IPSO object should be used to report the measured value of a 
        colour sensor in some colour space described by the units resource.

if LWM2M_IPSO_APP_COLOUR_SENSOR
config LWM2M_IPSO_APP_COLOUR_SENSOR_INSTANCE_COUNT
	int "Number of colour sensors present on board"
	default 1
    depends on LWM2M_IPSO_APP_COLOUR_SENSOR
	help
        Total count of IPSO Colour instances
        available to the LWM2M client.

choice
	prompt "IPSO Colour object version"
	depends on LWM2M_IPSO_APP_COLOUR_SENSOR
	default LWM2M_IPSO_APP_COLOUR_SENSOR_VERSION_1_0
	help
	  Select which version of the IPSO Colour object should be used.

config LWM2M_IPSO_APP_COLOUR_SENSOR_VERSION_1_0
	bool "IPSO Colour object version 1.0"

config LWM2M_IPSO_APP_COLOUR_SENSOR_VERSION_1_1
	bool "IPSO Colour object version 1.1"
endchoice # IPSO Colour object version
endif # LWM2M_IPSO_APP_COLOUR_SENSOR

endmenu # LWM2M ipso app
```

## samples/nrf9160/lwm2m_demo/src/ipso/Kconfig.buzzer
```kconfig
config LWM2M_IPSO_APP_BUZZER
    bool 
    help
        This IPSO object is used to actuate an audible alarm such as a buzzer,
	    beeper, or vibration alarm.

if LWM2M_IPSO_APP_BUZZER
config LWM2M_IPSO_APP_BUZZER_INSTANCE_COUNT
    int 
	default 1

	help
        Total count of IPSO Buzzer instances
        available to the LWM2M client.
endif # LWM2M_IPSO_APP_BUZZER
```

## samples/nrf9160/lwm2m_demo/src/ipso/Kconfig.ipso_buzzer
```kconfig
#
# Copyright (c) 2021 Nordic Semiconductor ASA
#
# SPDX-License-Identifier: LicenseRef-Nordic-5-Clause
#

config LWM2M_IPSO_APP_BUZZER
	bool
	help
		This IPSO object is used to actuate an audible alarm such as a buzzer,
		beeper, or vibration alarm.

if LWM2M_IPSO_APP_BUZZER
config LWM2M_IPSO_APP_BUZZER_INSTANCE_COUNT
	int
	default 1
	help
		Total count of IPSO Buzzer instances
		available to the LWM2M client.

choice
	prompt "Select IPSO Buzzer object version"
	default LWM2M_IPSO_APP_BUZZER_VERSION_1_0

config LWM2M_IPSO_APP_BUZZER_VERSION_1_0
	bool "Version 1.0"

config LWM2M_IPSO_APP_BUZZER_VERSION_1_1
	bool "Version 1.1"
endchoice # Select IPSO Buzzer object version
endif # LWM2M_IPSO_APP_BUZZER
```

## samples/nrf9160/lwm2m_demo/src/lwm2m/Kconfig
```kconfig
menu "LWM2M app"

config LWM2M_APP_BUZZER
    bool "Enable LWM2M buzzer support"
    default y if BOARD_THINGY91_NRF9160NS
    default n if BOARD_NRF9160DK_NRF9160NS
    depends on LWM2M_IPSO_APP_BUZZER
    depends on UI_BUZZER
    help
        Create a buzzer LWM2M object. Should not be enabled
        on the nRF9160 DK, as it has no buzzer.


config LWM2M_APP_LIGHT_CONTROL
    bool "Enable LWM2M light control support"
    default y
    depends on LWM2M_IPSO_LIGHT_CONTROL
    depends on UI_LED
    help
        Create light control LWM2M object(s). The nRF9160 DK
        will have multiple object instances (one for each LED),
        if UI_LED_USE_GPIO is chosen.


config LWM2M_APP_PUSH_BUTTON
    bool "Enable LWM2M button support"
    default y
    depends on LWM2M_IPSO_PUSH_BUTTON
    depends on UI_BUTTON
    help
        Create button LWM2M object(s). The nRF9160 DK
        will have two object instances, one for each push button.


config LWM2M_APP_LIGHT_SENSOR
    bool "Enable LWM2M light sensor support"
    default y
    depends on LWM2M_IPSO_APP_COLOUR_SENSOR
    help
        Create LWM2M light sensor objects. 
        It uses the IPSO Colour object. 
        The nRF9160 DK will only display simulated (constant)
        sensor values.


config LWM2M_APP_ENVIRONMENT_SENSOR
    bool "Enable LWM2M environment sensor support"
    default y
    depends on LWM2M_IPSO_TEMP_SENSOR
    depends on LWM2M_IPSO_PRESSURE_SENSOR
    depends on LWM2M_IPSO_HUMIDITY_SENSOR
    depends on LWM2M_IPSO_GENERIC_SENSOR
    help
        Create LWM2M objects for a temperature sensor,
        pressure sensor, humidity sensor and 
        gas resistance sensor.
        The nRF9160 DK will only display simulated (constant)
        sensor values.

endmenu # LWM2M app
```
