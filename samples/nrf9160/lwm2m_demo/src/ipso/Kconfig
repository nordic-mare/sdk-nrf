## samples/nrf9160/lwm2m_demo/src/sensors/Kconfig
```kconfig
menu "Sensors"

config ENVIRONMENT_SENSOR
	bool "Enable environment sensor"

if ENVIRONMENT_SENSOR
choice
	prompt "Environment sensor device"
	default ENV_SENSOR_USE_EXTERNAL

config ENV_SENSOR_USE_EXTERNAL
	bool "Use the BME680 environment sensor"
	depends on BME680

config ENV_SENSOR_USE_SIM
	bool "Simulate environment sensor"
	depends on SENSOR_SIM
	help
		Use sensor simulator to generate data.
		Gas resistance is not supported by the sensor simulator,
		and gas_res_read() will return an unchanged value.
endchoice # Environment sensor device

if ENV_SENSOR_USE_SIM
config ENV_SENSOR_GAS_RES_SIM_VAL
	int "Simulated gas resistance value"
	default 10000
	help
		Gas resistance in Ohm that will be
		returned when the environment sensor is simulated,
		as the sensor simulator does not have generic sensor
		support.
endif # ENV_SENSOR_USE_SIM
endif # ENVIRONMENT_SENSOR

config ACCELEROMETER
	bool "Enable accelerometer"

if ACCELEROMETER
choice 
	prompt "Accelerometer device"
	default ACCEL_USE_EXTERNAL

config ACCEL_USE_EXTERNAL
	bool "Use the ADXL362 accelerometer"
	depends on ADXL362

config ACCEL_USE_SIM
	bool "Simulate accelerometer"
	depends on SENSOR_SIM
	help
		Use sensor simulator to generate accelerometer data.
endchoice # Accelerometer device

config ACCEL_CALIBRATE
	bool "Calibrate the accelerometer on startup"
	default y
	help
		Calibrate the accelerometer on a flat surface to filter away
		static measurement offset that could affect orientation
		detection.

config ACCEL_CALIBRATION_ITERATIONS
	int "Number of measurements per channel during calibration"
	default 5
endif # ACCELEROMETER


config LIGHT_SENSOR
    bool "Enable light sensor"

if LIGHT_SENSOR
choice 
	prompt "Light sensor device"
	default LIGHT_SENSOR_USE_EXTERNAL

config LIGHT_SENSOR_USE_EXTERNAL
	bool "Use the BH1749 light sensor"
	depends on BH1749
	depends on UI_SENSE_LED

config LIGHT_SENSOR_USE_SIM
	bool "Simulate light sensor"
endchoice # Light sensor device

config LIGHT_SENSOR_LIGHT_MEASUREMENT_MAX_VALUE
    int "Max expected light sensor output value"
	default 500
	help
		Maximum value expected from the light sensor.
		Used to scale each color measurement to an 8-bit, unsigned
		integer. 
		Reasonable values will depend on the sensors environment.
		Max of a series of raw measurements during particular use conditions
		can give a good estimate (for that condition).

config LIGHT_SENSOR_COLOUR_MEASUREMENT_MAX_VALUE
	int "Max expected colour sensor output value"
	default 500
	help
		Maximum value expected from the colour sensor. 
		Used to scale each color measurement to an 8-bit, unsigned
		integer. 
		Reasonable values will depend on the sensors environment.
		Max of a series of raw measurements during particular use conditions
		can give a good estimate (for that condition).

if LIGHT_SENSOR_USE_SIM
config LIGHT_SENSOR_LIGHT_SIM_VAL
	int "Simulated light value for all channels"
	default 50
	help
		Simulated light value. Wil be scaled to 
		uint8_t, so this value should be smaller than
		LIGHT_SENSOR_LIGHT_MEASUREMENT_MAX_VALUE. 

config LIGHT_SENSOR_COLOUR_SIM_VAL
	int "Simulated colour value for all channels"
	default 250
	help
		Simulated colour value. Wil be scaled to 
		uint8_t, so this value should be smaller than
		LIGHT_SENSOR_COLOUR_MEASUREMENT_MAX_VALUE. 
endif # LIGHT_SENSOR_USE_SIM
endif # LIGHT_SENSOR

config GPS
	bool "Enable GPS"
	select LWM2M_LOCATION_OBJ_SUPPORT
	default y

choice
	prompt "GPS device"
	default GPS_USE_EXTERNAL
	depends on GPS
	help
		Select from which device GPS data will be fetched.

config GPS_USE_SIM
	bool "Use GPS simulator"
	select GPS_SIM
	select GPS_SIM_TRIGGER
	help
		Use simulated GPS data.

config GPS_USE_EXTERNAL
	bool "User provided GPS device"
	select NRF9160_GPS
	help
		Provide a GPS device that location data will be fetched from and
		sent to the LWM2M server.

endchoice

if GPS_USE_SIM

config GPS_DEV_NAME
	string
	default GPS_SIM_DEV_NAME

config GPS_TRIGGER
	bool
	default GPS_SIM_TRIGGER

endif

if GPS_USE_EXTERNAL
config GPS_DEV_NAME
	string "GPS device name"
	default "NRF9160_GPS"
	help
		GPS device from which location data will be fetched and sent
		to nRF Cloud.
endif

config GPS_SEARCH_INTERVAL_TIME
	int "GPS search interval [s]"
	default 300
	depends on GPS
	help
		Length of time between GPS searches in seconds.

config GPS_SEARCH_TIMEOUT_TIME
	int "GPS search timeout [s]"
	default 270
	depends on GPS
	help
		Length of time the GPS can spend looking for a fix in seconds. 
		In areas with poor connection, this should be increased.

endmenu # Sensors
```

## samples/nrf9160/lwm2m_demo/src/sensors/Kconfig.gps
```kconfig
# 
# Copyright (c) 2021 Nordic Semiconductor ASA
#
# SPDX-License-Identifier: LicenseRef-Nordic-5-Clause
#

config GPS
	bool
	help
        Enable GPS

if GPS
choice
	prompt "GPS device"
	default GPS_USE_EXTERNAL
	help
		Select from which device GPS data will be fetched.

config GPS_USE_SIM
	bool "Use GPS simulator"
	select GPS_SIM
	select GPS_SIM_TRIGGER
	help
		Use simulated GPS data.

config GPS_USE_EXTERNAL
	bool "User provided GPS device"
	select NRF9160_GPS
	help
		Provide a GPS device that location data will be fetched from and
		sent to the LWM2M server.
endchoice # GPS device

if GPS_USE_SIM
config GPS_DEV_NAME
	string
	default GPS_SIM_DEV_NAME

config GPS_TRIGGER
	bool
	default GPS_SIM_TRIGGER
endif # GPS_USE_SIM

if GPS_USE_EXTERNAL
config GPS_DEV_NAME
	string "GPS device name"
	default "NRF9160_GPS"
	help
		GPS device from which location data will be fetched and sent
		to nRF Cloud.
endif # GPS_USE_EXTERNAL

config GPS_SEARCH_INTERVAL_TIME
	int "GPS search interval [s]"
	default 300
	depends on GPS
	help
		Length of time between GPS searches in seconds.

config GPS_SEARCH_TIMEOUT_TIME
	int "GPS search timeout [s]"
	default 270
	depends on GPS
	help
		Length of time the GPS can spend looking for a fix in seconds. 
		In areas with poor connection, this should be increased.
endif #GPS
```

## samples/nrf9160/lwm2m_demo/src/sensors/Kconfig.light_sensor
```kconfig
config LIGHT_SENSOR
    bool
	help
		Enable the light sensor device. 

if LIGHT_SENSOR
choice 
	prompt "Select light sensor device"
	default LIGHT_SENSOR_USE_EXTERNAL

config LIGHT_SENSOR_USE_EXTERNAL
	bool "Use the BH1749 light sensor"
	depends on BH1749
	select UI_SENSE_LED

config LIGHT_SENSOR_USE_SIM
	bool "Simulate light sensor"
endchoice # Light sensor device

config LIGHT_SENSOR_LIGHT_MEASUREMENT_MAX_VALUE
    int "Max expected light sensor output value"
	default 500
	help
		Maximum value expected from the light sensor.
		Used to scale each color measurement to an 8-bit, unsigned
		integer. 
		Reasonable values will depend on the sensors environment.
		Max of a series of raw measurements during particular use conditions
		can give a good estimate (for that condition).

config LIGHT_SENSOR_COLOUR_MEASUREMENT_MAX_VALUE
	int "Max expected colour sensor output value"
	default 500
	help
		Maximum value expected from the colour sensor. 
		Used to scale each color measurement to an 8-bit, unsigned
		integer. 
		Reasonable values will depend on the sensors environment.
		Max of a series of raw measurements during particular use conditions
		can give a good estimate (for that condition).

if LIGHT_SENSOR_USE_SIM
config LIGHT_SENSOR_LIGHT_SIM_VAL
	int "Simulated light value for all channels"
	default 50
	help
		Simulated light value. Wil be scaled to 
		uint8_t, so this value should be smaller than
		LIGHT_SENSOR_LIGHT_MEASUREMENT_MAX_VALUE. 

config LIGHT_SENSOR_COLOUR_SIM_VAL
	int "Simulated colour value for all channels"
	default 250
	help
		Simulated colour value. Wil be scaled to 
		uint8_t, so this value should be smaller than
		LIGHT_SENSOR_COLOUR_MEASUREMENT_MAX_VALUE. 
endif # LIGHT_SENSOR_USE_SIM
endif # LIGHT_SENSOR
```

## samples/nrf9160/lwm2m_demo/src/ui/Kconfig
```kconfig
#
# Copyright (c) 2019 Nordic Semiconductor ASA
#
# SPDX-License-Identifier: LicenseRef-Nordic-5-Clause
#

menu "User Interface"
visible if FALSE # Hide menu

config UI_LED
	bool
	help
		Enable LEDs.

config UI_BUZZER
	bool
	select PWM
	select PWM_1
	help
		If enabled, a buzzer will be controllable with PWM.


config UI_INPUT
	bool
	select DK_LIBRARY
	select DK_LIBRARY_INVERT_LEDS
	help
		Enable switches and buttons.


config UI_SENSE_LED
	bool
	help
		Enables the sense LEDs available on the Thingy:91.

endmenu # User Interface

module = UI
module-str = User Interface
source "${ZEPHYR_BASE}/subsys/logging/Kconfig.template.log_config"
```
