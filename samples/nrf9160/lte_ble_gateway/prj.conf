## Kconfig
```
#
# Copyright (c) 2018 Nordic Semiconductor ASA
#
# SPDX-License-Identifier: LicenseRef-Nordic-5-Clause
#

menu "LTE BLE gateway sample"

config CLOUD_BACKEND
	string "Selects the cloud backend to be used"
	default "NRF_CLOUD"
	help
	  Possible values are "NRF_CLOUD".

choice
	prompt "GPS device"
	default GPS_USE_SIM
	help
		Select from which device GPS data will be fetched.

config GPS_USE_SIM
	bool "Use GPS simulator"
	select GPS_SIM
	select GPS_SIM_TRIGGER
	help
		Use simulated GPS data.

config GPS_USE_NRF9160
	bool "User provided GPS device"
	help
		Provide a GPS device that location data will be fetched from and
		sent to nRF Cloud

endchoice

config GPS_DEV_NAME
	string
	default GPS_SIM_DEV_NAME if GPS_USE_SIM
	default "NRF9160_GPS" if GPS_USE_NRF9160

config GPS_SEARCH_INTERVAL
	int "Interval for starting GPS search"
	default 240

config GPS_SEARCH_TIMEOUT
	int "Timeout for GPS search"
	default 120
	help
	  The GPS will stop acquiring GPS fix when it times out.
	  It will restart the search at the start of the next search interval.

endmenu

menu "Zephyr Kernel"
source "Kconfig.zephyr"
endmenu
```

## prj.conf
```kconfig
#
# Copyright (c) 2019 Nordic Semiconductor ASA
#
# SPDX-License-Identifier: LicenseRef-Nordic-5-Clause
#
# General config
CONFIG_NEWLIB_LIBC=y
CONFIG_ASSERT=y
CONFIG_REBOOT=y

# Network
CONFIG_NETWORKING=y
CONFIG_NET_NATIVE=n
CONFIG_NET_SOCKETS=y
CONFIG_NET_SOCKETS_OFFLOAD=y

# LTE link control
CONFIG_LTE_LINK_CONTROL=y
CONFIG_LTE_AUTO_INIT_AND_CONNECT=n

# AT host
CONFIG_AT_HOST_LIBRARY=y

# Modem library
CONFIG_NRF_MODEM_LIB=y

# Disable Modem traces, since we need UART1 for HCI
CONFIG_NRF_MODEM_LIB_TRACE_ENABLED=n

# nRF Cloud
CONFIG_NRF_CLOUD=y
CONFIG_NRF_CLOUD_MQTT=y

# JSON
CONFIG_JSON_LIBRARY=y

# Cloud API
CONFIG_CLOUD_API=y

# GPS
CONFIG_GPS_USE_SIM=y

# For demo purposes, we acquire fix often
CONFIG_GPS_SEARCH_INTERVAL=30
CONFIG_GPS_SEARCH_TIMEOUT=15

# The two configurations below are required if using the nRF9160's built-in GPS
# CONFIG_NRF9160_GPS=y
# CONFIG_GPS_USE_NRF9160=y

# Library for buttons and LEDs
CONFIG_DK_LIBRARY=y
CONFIG_DK_LIBRARY_INVERT_LEDS=n

# Console for user association
CONFIG_CONSOLE_SUBSYS=y
CONFIG_CONSOLE_GETCHAR=y

# Enable Bluetooth stack and libraries
CONFIG_BT=y
CONFIG_BT_H4=y
CONFIG_BT_WAIT_NOP=y
CONFIG_BT_CENTRAL=y
CONFIG_BT_GATT_CLIENT=y
CONFIG_BT_GATT_DM=y
CONFIG_BT_SCAN=y
CONFIG_BT_SCAN_FILTER_ENABLE=y
CONFIG_BT_SCAN_UUID_CNT=1

CONFIG_UART_INTERRUPT_DRIVEN=y

# Heap and stacks
CONFIG_HEAP_MEM_POOL_SIZE=16384
CONFIG_MAIN_STACK_SIZE=8192
```

## src/main.c
```c
/*
 * Copyright (c) 2018 Nordic Semiconductor ASA
 *
 * SPDX-License-Identifier: LicenseRef-Nordic-5-Clause
 */

#include <zephyr.h>
#include <stdio.h>
#include <string.h>
#include <drivers/gps.h>
#include <drivers/sensor.h>
#include <console/console.h>
#include <net/cloud.h>
#include <dk_buttons_and_leds.h>
#include <modem/lte_lc.h>
#include <sys/reboot.h>
#include <modem/nrf_modem_lib.h>
#include <data/json.h>

#include "aggregator.h"
#include "ble.h"

#include "alarm.h"

/* Interval in milliseconds between each time status LEDs are updated. */
#define LEDS_UPDATE_INTERVAL K_MSEC(500)

/* Interval in microseconds between each time LEDs are updated when indicating
 * that an error has occurred.
 */
#define LEDS_ERROR_UPDATE_INTERVAL 250000

#define BUTTON_1 BIT(0)
#define BUTTON_2 BIT(1)
#define SWITCH_1 BIT(2)
#define SWITCH_2 BIT(3)

#define LED_ON(x) (x)
#define LED_BLINK(x) ((x) << 8)
#define LED_GET_ON(x) ((x)&0xFF)
#define LED_GET_BLINK(x) (((x) >> 8) & 0xFF)

/* Interval in milliseconds after the device will retry cloud connection
 * if the event NRF_CLOUD_EVT_TRANSPORT_CONNECTED is not received.
 */
#define RETRY_CONNECT_WAIT K_MSEC(90000)

enum {
	LEDS_INITIALIZING = LED_ON(0),
	LEDS_LTE_CONNECTING = LED_BLINK(DK_LED3_MSK),
	LEDS_LTE_CONNECTED = LED_ON(DK_LED3_MSK),
	LEDS_CLOUD_CONNECTING = LED_BLINK(DK_LED4_MSK),
	LEDS_CLOUD_PAIRING_WAIT = LED_BLINK(DK_LED3_MSK | DK_LED4_MSK),
	LEDS_CLOUD_CONNECTED = LED_ON(DK_LED4_MSK),
	LEDS_ERROR = LED_ON(DK_ALL_LEDS_MSK)
} display_state;

static struct cloud_backend *cloud_backend;

/* Sensor data */
static struct gps_nmea gps_nmea_data;
static struct cloud_sensor_data gps_cloud_data = {
	.type = "GPS",
	.tag = 0x1,
	.data = gps_nmea_data.buf,
	.length = GPS_NMEA_SENTENCE_MAX_LENGTH,
};
static atomic_val_t send_data_enable;

/* Structures for work */
static struct k_work_delayable leds_update_work;
static struct k_work_delayable connect_work;

static bool cloud_connected;

enum error_type {
	ERROR_NRF_CLOUD,
	ERROR_MODEM_RECOVERABLE,
};

struct cloud_data {
	const char *app_id;
	const char *data;
	const char *message_type;
};

struct json_obj_descr cloud_data_descr[] = {
	JSON_OBJ_DESCR_PRIM(struct cloud_data, app_id, JSON_TOK_STRING),
	JSON_OBJ_DESCR_PRIM(struct cloud_data, data, JSON_TOK_STRING),
	JSON_OBJ_DESCR_PRIM(struct cloud_data, message_type, JSON_TOK_STRING)
};

/* Forward declaration of functions */
static void cloud_connect_work(struct k_work *work);
static void sensors_init(void);
static void work_init(void);

void cloud_update(struct cloud_sensor_data cloud_data);

/**@brief nRF Cloud error handler. */
void error_handler(enum error_type err_type, int err)
{
	if (err_type == ERROR_NRF_CLOUD) {
		int err;

		/* Turn off and shutdown modem */
		k_sched_lock();
		err = lte_lc_power_off();
		__ASSERT(err == 0, "lte_lc_power_off failed: %d", err);
		nrf_modem_lib_shutdown();
	}

#if !defined(CONFIG_DEBUG)
	sys_reboot(SYS_REBOOT_COLD);
#else
	uint8_t led_pattern;

	switch (err_type) {
	case ERROR_NRF_CLOUD:
		/* Blinking all LEDs ON/OFF in pairs (1 and 4, 2 and 3)
		 * if there is an application error.
		 */
		led_pattern = DK_LED1_MSK | DK_LED4_MSK;
		printk("Error of type ERROR_NRF_CLOUD: %d\n", err);
		break;
	case ERROR_MODEM_RECOVERABLE:
		/* Blinking all LEDs ON/OFF in pairs (1 and 3, 2 and 4)
		 * if there is a recoverable error.
		 */
		led_pattern = DK_LED1_MSK | DK_LED3_MSK;
		printk("Error of type ERROR_MODEM_RECOVERABLE: %d\n", err);
		break;
	default:
		/* Blinking all LEDs ON/OFF in pairs (1 and 2, 3 and 4)
		 * undefined error.
		 */
		led_pattern = DK_LED1_MSK | DK_LED2_MSK;
		break;
	}

	while (true) {
		dk_set_leds(led_pattern & 0x0f);
		k_busy_wait(LEDS_ERROR_UPDATE_INTERVAL);
		dk_set_leds(~led_pattern & 0x0f);
		k_busy_wait(LEDS_ERROR_UPDATE_INTERVAL);
	}
#endif /* CONFIG_DEBUG */
}

void nrf_cloud_error_handler(int err)
{
	error_handler(ERROR_NRF_CLOUD, err);
}

/**@brief Callback for GPS events */
static void gps_handler(const struct device *dev, struct gps_event *evt)
{
	uint32_t button_state, has_changed;
	struct sensor_data in_data = {
		.type = GPS_POSITION,
		.length = evt->nmea.len,
	};

	ARG_UNUSED(dev);

	switch (evt->type) {
	case GPS_EVT_SEARCH_STARTED:
		printk("GPS_EVT_SEARCH_STARTED\n");
		return;
	case GPS_EVT_SEARCH_STOPPED:
		printk("GPS_EVT_SEARCH_STOPPED\n");
		return;
	case GPS_EVT_SEARCH_TIMEOUT:
		printk("GPS_EVT_SEARCH_TIMEOUT\n");
		return;
	case GPS_EVT_PVT_FIX:
		printk("GPS_EVT_PVT_FIX\n");
		return;
	case GPS_EVT_NMEA_FIX:
		printk("GPS_EVT_NMEA_FIX\n");
		break;
	default:
		return;
	}

	dk_read_buttons(&button_state, &has_changed);

	if ((button_state & SWITCH_2) || !atomic_get(&send_data_enable)) {
		return;
	}

	gps_cloud_data.tag++;

	if (gps_cloud_data.tag == 0) {
		gps_cloud_data.tag = 0x1;
	}

	memcpy(&in_data.data[0], &gps_cloud_data.tag, sizeof(gps_cloud_data.tag));

	memcpy(&in_data.data[sizeof(gps_cloud_data.tag)], evt->nmea.buf, evt->nmea.len);

	if (aggregator_put(in_data) != 0) {
		printk("Failed to store GPS data.\n");
	}
}

/**@brief Update LEDs state. */
static void leds_update(struct k_work *work)
{
	static bool led_on;
	static uint8_t current_led_on_mask;
	uint8_t led_on_mask = current_led_on_mask;

	ARG_UNUSED(work);

	/* Reset LED3 and LED4. */
	led_on_mask &= ~(DK_LED3_MSK | DK_LED4_MSK);

	/* Set LED3 and LED4 to match current state. */
	led_on_mask |= LED_GET_ON(display_state);

	led_on = !led_on;
	if (led_on) {
		led_on_mask |= LED_GET_BLINK(display_state);
	} else {
		led_on_mask &= ~LED_GET_BLINK(display_state);
	}

	if (led_on_mask != current_led_on_mask) {
		dk_set_leds(led_on_mask);
		current_led_on_mask = led_on_mask;
	}

	k_work_schedule(&leds_update_work, LEDS_UPDATE_INTERVAL);
}

void cloud_update(struct cloud_sensor_data cloud_data) {
	int err;

	if (!cloud_connected) {
		printk("Not connected to cloud, aborting cloud publication\n");
		return;
	}

	struct cloud_data json_data = {
		.app_id = cloud_data.type,
		.data = cloud_data.data, // TODO: Fix
		.message_type = "DATA"
	};

	ssize_t json_len = json_calc_encoded_len(cloud_data_descr, ARRAY_SIZE(cloud_data_descr), &json_data) + 1;
	char json_buffer[json_len];

	err = json_obj_encode_buf(cloud_data_descr, ARRAY_SIZE(cloud_data_descr), &json_data, json_buffer, sizeof(json_buffer));
	if (err) {
		printk("Failed encoding sensor data as JSON: %d\n", err);
	}
	struct cloud_msg msg = {
		.qos = CLOUD_QOS_AT_MOST_ONCE,
		.buf = json_buffer,
		.len = json_len
	};

	if (strcmp(CONFIG_CLOUD_BACKEND, "NRF_CLOUD") == 0) {
		msg.endpoint.type = CLOUD_EP_MSG;
	} else {
		msg.endpoint.type = CLOUD_EP_STATE;
	}

	err = cloud_send(cloud_backend, &msg);
	if (err) {
		printk("Failed updating cloud, error %d", err);
	}
}

/**@brief Callback for Cloud events. */
void cloud_event_handler(const struct cloud_backend *const backend,
			 const struct cloud_event *const evt, void *user_data)
{
	switch (evt->type) {
	case CLOUD_EVT_CONNECTING:
		printk("CLOUD_EVT_CONNECTING\n");
		break;
	case CLOUD_EVT_CONNECTED:
		printk("CLOUD_EVT_CONNECTED\n");
		cloud_connected = true;
		/* This may fail if the work item is already being processed,
		 * but in such case, the next time the work handler is executed,
		 * it will exit after checking the above flag and the work will
		 * not be scheduled again.
		 */
		(void)k_work_cancel_delayable(&connect_work);
		break;
	case CLOUD_EVT_READY:
		printk("CLOUD_EVT_READY\n");
		display_state = LEDS_CLOUD_CONNECTED;
		sensors_init();
		atomic_set(&send_data_enable, 1);
		break;
	case CLOUD_EVT_DISCONNECTED:
		printk("CLOUD_EVT_DISCONNECTED\n");
		cloud_connected = false;
		k_work_reschedule(&connect_work, K_NO_WAIT);
		break;
	case CLOUD_EVT_ERROR:
		printk("CLOUD_EVT_ERROR\n");
		atomic_set(&send_data_enable, 0);
		display_state = LEDS_ERROR;
		break;
	case CLOUD_EVT_DATA_SENT:
		printk("CLOUD_EVT_DATA_SENT\n");
		break;
	case CLOUD_EVT_DATA_RECEIVED:
		printk("CLOUD_EVT_DATA_RECEIVED\n");
		break;
	case CLOUD_EVT_PAIR_REQUEST:
		printk("CLOUD_EVT_PAIR_REQUEST\n");
		break;
	case CLOUD_EVT_PAIR_DONE:
		printk("CLOUD_EVT_PAIR_DONE\n");
		break;
	case CLOUD_EVT_FOTA_DONE:
		printk("CLOUD_EVT_FOTA_DONE\n");
		break;
	case CLOUD_EVT_FOTA_ERROR:
		printk("CLOUD_EVT_FOTA_ERROR\n");
		break;
	default:
		printk("Unknown cloud event type: %d\n", evt->type);
		break;
	}
}

/**@brief Connect to Cloud, */
static void cloud_connect_work(struct k_work *work)
{
	int err;

	ARG_UNUSED(work);

	if (cloud_connected) {
		return;
	}

	err = cloud_connect(cloud_backend);

	if (err) {
		printk("Failed to connect to cloud: %d\n", err);
		printk("Retrying in 90 seconds");
		k_work_schedule(&connect_work, RETRY_CONNECT_WAIT);
	}

	display_state = LEDS_CLOUD_CONNECTING;
	k_work_schedule(&connect_work, RETRY_CONNECT_WAIT);
}

/**@brief Callback for button events from the DK buttons and LEDs library. */
static void button_handler(uint32_t buttons, uint32_t has_changed)
{
	printk("button_handler: button 1: %u, button 2: %u "
	       "switch 1: %u, switch 2: %u\n",
	       (bool)(buttons & BUTTON_1), (bool)(buttons & BUTTON_2), (bool)(buttons & SWITCH_1),
	       (bool)(buttons & SWITCH_2));
}

/**@brief Initializes and submits delayed work. */
static void work_init(void)
{
	k_work_init_delayable(&leds_update_work, leds_update);
	k_work_init_delayable(&connect_work, cloud_connect_work);
	k_work_schedule(&leds_update_work, LEDS_UPDATE_INTERVAL);
}

/**@brief Configures modem to provide LTE link. Blocks until link is
 * successfully established.
 */
static void modem_configure(void)
{
	display_state = LEDS_LTE_CONNECTING;

	if (IS_ENABLED(CONFIG_LTE_AUTO_INIT_AND_CONNECT)) {
		/* Do nothing, modem is already turned on and connected. */
	} else {
		int err;

		printk("Establishing LTE link (this may take some time) ...\n");
		err = lte_lc_init_and_connect();
		__ASSERT(err == 0, "LTE link could not be established.");
		display_state = LEDS_LTE_CONNECTED;
	}
}

/**@brief Initializes the sensors that are used by the application. */
static void sensors_init(void)
{
	int err;
	const struct device *gps_dev = device_get_binding(CONFIG_GPS_DEV_NAME);
	struct gps_config gps_cfg = {
		.nav_mode = GPS_NAV_MODE_PERIODIC,
		.interval = CONFIG_GPS_SEARCH_INTERVAL,
		.timeout = CONFIG_GPS_SEARCH_TIMEOUT,
	};

	if (gps_dev == NULL) {
		printk("Could not get %s device\n", CONFIG_GPS_DEV_NAME);
		return;
	}

	err = gps_init(gps_dev, gps_handler);
	if (err) {
		printk("Could not initialize GPS, error: %d\n", err);
		return;
	}

	printk("GPS initialized\n");

	err = gps_start(gps_dev, &gps_cfg);
	if (err) {
		printk("Failed to start GPS, error: %d\n", err);
		return;
	}

	printk("GPS started with interval %d seconds, and timeout %d seconds\n",
	       CONFIG_GPS_SEARCH_INTERVAL, CONFIG_GPS_SEARCH_TIMEOUT);
}

/**@brief Initializes buttons and LEDs, using the DK buttons and LEDs
 * library.
 */
static void buttons_leds_init(void)
{
	int err;

	err = dk_buttons_init(button_handler);
	if (err) {
		printk("Could not initialize buttons, err code: %d\n", err);
	}

	err = dk_leds_init();
	if (err) {
		printk("Could not initialize leds, err code: %d\n", err);
	}

	err = dk_set_leds_state(0x00, DK_ALL_LEDS_MSK);
	if (err) {
		printk("Could not set leds state, err code: %d\n", err);
	}
}

void main(void)
{
	int err;

	printk("LTE Sensor Gateway sample started\n");

	buttons_leds_init();
	ble_init();

	cloud_backend = cloud_get_binding(CONFIG_CLOUD_BACKEND);
	err = cloud_init(cloud_backend, cloud_event_handler);
	if (err) {
		printk("Cloud backend could not be initialized, error: %d", err);
	}
	modem_configure();
	cloud_connect(cloud_backend);

	work_init();

	while (true) {
		cloud_ping(cloud_backend);
		send_aggregated_data();
		k_sleep(K_MSEC(10));
	}
}
```

## src/alarm.c
```c
/*
 * Copyright (c) 2018 Nordic Semiconductor ASA
 *
 * SPDX-License-Identifier: LicenseRef-Nordic-5-Clause
 */
#include <string.h>
#include <stdbool.h>
#include <sys/printk.h>
#include <net/cloud.h>

#include "alarm.h"

#include "aggregator.h"

static bool alarm_pending;

extern void cloud_update(struct cloud_sensor_data cloud_data);

char *orientation_strings[] = { "LEFT", "NORMAL", "RIGHT", "UPSIDE_DOWN" };

void alarm(void)
{
	alarm_pending = true;
}

void send_aggregated_data(void)
{
	struct sensor_data aggregator_data;
	struct cloud_sensor_data cloud_data;

	if (!alarm_pending) {
		return;
	}

	alarm_pending = false;

	printk("Alarm triggered !\n");
	while (true) {
		if (aggregator_get(&aggregator_data) == -ENODATA) {
			break;
		}
		switch (aggregator_data.type) {
		case THINGY_ORIENTATION:
			printk("%d] Sending FLIP data.\n", aggregator_element_count_get());
			if (aggregator_data.length != 1 ||
			    aggregator_data.data[0] >= ARRAY_SIZE(orientation_strings)) {
				printk("Unexpected FLIP data format, dropping\n");
				continue;
			}
			cloud_data.type = "FLIP";
			cloud_data.data = orientation_strings[aggregator_data.data[0]];
			cloud_data.length =
				strlen(orientation_strings[aggregator_data.data[0]]) - 1;
			cloud_update(cloud_data);
			break;

		case GPS_POSITION:
			printk("%d] Sending GPS data.\n", aggregator_element_count_get());
			cloud_data.type = "GPS";
			cloud_data.data = &aggregator_data.data[4];
			cloud_data.length = aggregator_data.length;
			cloud_update(cloud_data);
			break;

		default:
			printk("Unsupported data type from aggregator: %d.\n",
			       aggregator_data.type);
			continue;
		}
	}
}
```

## src/alarm.h
```c
/*
 * Copyright (c) 2018 Nordic Semiconductor ASA
 *
 * SPDX-License-Identifier: LicenseRef-Nordic-5-Clause
 */

#ifndef _ALARM_H_
#define _ALARM_H_

struct cloud_sensor_data {
	char *type;
	char *data;
    uint16_t tag;
	uint8_t length;
};

void alarm(void);
void send_aggregated_data(void);

#endif /* _ALARM_H_ */
```

## src/ble.c
```c
/*
 * Copyright (c) 2018 Nordic Semiconductor ASA
 *
 * SPDX-License-Identifier: LicenseRef-Nordic-5-Clause
 */

#include <zephyr.h>

#include <bluetooth/bluetooth.h>
#include <bluetooth/gatt.h>
#include <bluetooth/uuid.h>
#include <bluetooth/gatt_dm.h>
#include <bluetooth/scan.h>

#include <dk_buttons_and_leds.h>
#include <sys/byteorder.h>

#include "aggregator.h"

/* Thinghy advertisement UUID */
#define BT_UUID_THINGY_VAL \
	BT_UUID_128_ENCODE(0xef680100, 0x9b35, 0x4933, 0x9b10, 0x52ffa9740042)

#define BT_UUID_THINGY \
	BT_UUID_DECLARE_128(BT_UUID_THINGY_VAL)
/* Thingy service UUID */
#define BT_UUID_TMS_VAL \
	BT_UUID_128_ENCODE(0xef680400, 0x9b35, 0x4933, 0x9b10, 0x52ffa9740042)

#define BT_UUID_TMS \
	BT_UUID_DECLARE_128(BT_UUID_TMS_VAL)
		/* Thingy characteristic UUID */
#define BT_UUID_TOC_VAL \
	BT_UUID_128_ENCODE(0xef680403, 0x9b35, 0x4933, 0x9b10, 0x52ffa9740042)

#define BT_UUID_TOC \
	BT_UUID_DECLARE_128(BT_UUID_TOC_VAL)
extern void alarm(void);

static uint8_t on_received(struct bt_conn *conn,
			struct bt_gatt_subscribe_params *params,
			const void *data, uint16_t length)
{
	if (length > 0) {
		printk("Orientation: %x\n", ((uint8_t *)data)[0]);
		struct sensor_data in_data;

		in_data.type = THINGY_ORIENTATION;
		in_data.length = 1;
		in_data.data[0] = ((uint8_t *)data)[0];

		if (aggregator_put(in_data) != 0) {
			printk("Was not able to insert Thingy orientation data into aggregator.\n");
		}
		/* If the thingy is upside down, trigger an alarm. */
		if (((uint8_t *)data)[0] == 3) {
			alarm();
		}

	} else {
		printk("Orientation notification with 0 length\n");
	}
	return BT_GATT_ITER_CONTINUE;
}

static void discovery_completed(struct bt_gatt_dm *disc, void *ctx)
{
	int err;

	/* Must be statically allocated */
	static struct bt_gatt_subscribe_params param = {
		.notify = on_received,
		.value = BT_GATT_CCC_NOTIFY,
	};

	const struct bt_gatt_dm_attr *chrc;
	const struct bt_gatt_dm_attr *desc;

	chrc = bt_gatt_dm_char_by_uuid(disc, BT_UUID_TOC);
	if (!chrc) {
		printk("Missing Thingy orientation characteristic\n");
		goto release;
	}

	desc = bt_gatt_dm_desc_by_uuid(disc, chrc, BT_UUID_TOC);
	if (!desc) {
		printk("Missing Thingy orientation char value descriptor\n");
		goto release;
	}

	param.value_handle = desc->handle,

	desc = bt_gatt_dm_desc_by_uuid(disc, chrc, BT_UUID_GATT_CCC);
	if (!desc) {
		printk("Missing Thingy orientation char CCC descriptor\n");
		goto release;
	}

	param.ccc_handle = desc->handle;

	err = bt_gatt_subscribe(bt_gatt_dm_conn_get(disc), &param);
	if (err) {
		printk("Subscribe failed (err %d)\n", err);
	}

release:
	err = bt_gatt_dm_data_release(disc);
	if (err) {
		printk("Could not release discovery data, err: %d\n", err);
	}
}

static void discovery_service_not_found(struct bt_conn *conn, void *ctx)
{
	printk("Thingy orientation service not found!\n");
}

static void discovery_error_found(struct bt_conn *conn, int err, void *ctx)
{
	printk("The discovery procedure failed, err %d\n", err);
}

static struct bt_gatt_dm_cb discovery_cb = {
	.completed = discovery_completed,
	.service_not_found = discovery_service_not_found,
	.error_found = discovery_error_found,
};

static void connected(struct bt_conn *conn, uint8_t conn_err)
{
	int err;
	char addr[BT_ADDR_LE_STR_LEN];

	bt_addr_le_to_str(bt_conn_get_dst(conn), addr, sizeof(addr));

	if (conn_err) {
		printk("Failed to connect to %s (%u)\n", addr, conn_err);
		return;
	}

	printk("Connected: %s\n", addr);

	err = bt_gatt_dm_start(conn, BT_UUID_TMS, &discovery_cb, NULL);
	if (err) {
		printk("Could not start service discovery, err %d\n", err);
	}
}

static struct bt_conn_cb conn_callbacks = {
	.connected = connected,
};

void scan_filter_match(struct bt_scan_device_info *device_info,
		       struct bt_scan_filter_match *filter_match,
		       bool connectable)
{
	char addr[BT_ADDR_LE_STR_LEN];

	bt_addr_le_to_str(device_info->recv_info->addr, addr, sizeof(addr));

	printk("Device found: %s\n", addr);
}

void scan_connecting_error(struct bt_scan_device_info *device_info)
{
	printk("Connection to peer failed!\n");
}

BT_SCAN_CB_INIT(scan_cb, scan_filter_match, NULL, scan_connecting_error, NULL);

static void scan_start(void)
{
	int err;

	struct bt_le_scan_param scan_param = {
		.type = BT_LE_SCAN_TYPE_ACTIVE,
		.options = BT_LE_SCAN_OPT_FILTER_DUPLICATE,
		.interval = 0x0010,
		.window = 0x0010,
	};

	struct bt_scan_init_param scan_init = {
		.connect_if_match = 1,
		.scan_param = &scan_param,
		.conn_param = BT_LE_CONN_PARAM_DEFAULT,
	};

	bt_scan_init(&scan_init);
	bt_scan_cb_register(&scan_cb);

	err = bt_scan_filter_add(BT_SCAN_FILTER_TYPE_UUID, BT_UUID_THINGY);
	if (err) {
		printk("Scanning filters cannot be set\n");
		return;
	}

	err = bt_scan_filter_enable(BT_SCAN_UUID_FILTER, false);
	if (err) {
		printk("Filters cannot be turned on\n");
	}

	err = bt_scan_start(BT_SCAN_TYPE_SCAN_ACTIVE);
	if (err) {
		printk("Scanning failed to start, err %d\n", err);
	}

	printk("Scanning...\n");
}

static void ble_ready(int err)
{
	printk("Bluetooth ready\n");

	bt_conn_cb_register(&conn_callbacks);
	scan_start();
}

void ble_init(void)
{
	int err;

	printk("Initializing Bluetooth..\n");
	err = bt_enable(ble_ready);
	if (err) {
		printk("Bluetooth init failed (err %d)\n", err);
		return;
	}
}
```
