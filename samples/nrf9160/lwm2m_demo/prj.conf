## CMakeLists.txt
```
#
# Copyright (c) 2018 Nordic Semiconductor
#
# SPDX-License-Identifier: LicenseRef-Nordic-5-Clause
#

cmake_minimum_required(VERSION 3.13.1)

find_package(Zephyr REQUIRED HINTS $ENV{ZEPHYR_BASE})
project(lwm2m_client)
zephyr_compile_definitions(PROJECT_NAME=${PROJECT_NAME})

# NORDIC SDK APP START
target_sources(app PRIVATE src/main.c)
zephyr_include_directories(src)
# NORDIC SDK APP END

# Include application events and configuration headers
zephyr_library_include_directories(
	src/lwm2m
	src/ui
	src/ipso
	src/events
	src/sensors
	src/modules
	)

# Application sources
add_subdirectory(src/lwm2m)
add_subdirectory(src/ui)
add_subdirectory(src/ipso)
add_subdirectory(src/events)
add_subdirectory(src/sensors)
add_subdirectory(src/modules)
```

## Kconfig
```
#
# Copyright (c) 2018 Nordic Semiconductor ASA
#
# SPDX-License-Identifier: LicenseRef-Nordic-5-Clause
#

menu "Application sample"

rsource "src/ui/Kconfig"
rsource "src/modules/Kconfig"
rsource "src/lwm2m/Kconfig"

menu "LwM2M objects"
menu "Push buttons and on/off switches"
config APP_PUSH_BUTTON
	bool "Enable button(s)"
	select UI_INPUT
	select LWM2M_IPSO_PUSH_BUTTON
	select LWM2M_APP_PUSH_BUTTON


config APP_ONOFF_SWITCH
	bool "Enable switches"
	depends on BOARD_NRF9160DK_NRF9160NS
	select UI_INPUT
	select LWM2M_IPSO_ONOFF_SWITCH
	select LWM2M_APP_ONOFF_SWITCH
endmenu # Buttons and switches


menu "LEDs"
config APP_LIGHT_CONTROL
	bool "Enable LED(s)"
	select UI_LED
	select LWM2M_IPSO_LIGHT_CONTROL
	select LWM2M_APP_LIGHT_CONTROL

if APP_LIGHT_CONTROL
	rsource "src/ui/Kconfig.ui_led"
endif # APP_LIGHT_CONTROL
endmenu # LEDs


menu "Buzzer"
config APP_BUZZER
	bool "Enable buzzer"
	depends on BOARD_THINGY91_NRF9160NS
	select UI_BUZZER
	select LWM2M_IPSO_APP_BUZZER
	select LWM2M_APP_BUZZER

if APP_BUZZER
	rsource "src/ipso/Kconfig.ipso_buzzer"
endif # APP_BUZZER
endmenu # Buzzer


menu "Light sensor"
config APP_LIGHT_SENSOR
	bool "Enable light sensor"
	select LIGHT_SENSOR
	select LWM2M_IPSO_APP_COLOUR_SENSOR
	select LWM2M_APP_LIGHT_SENSOR

if APP_LIGHT_SENSOR
	rsource "src/sensors/Kconfig.light_sensor"
	rsource "src/ipso/Kconfig.ipso_colour_sensor"
endif # APP_LIGHT_SENSOR
endmenu # Light sensor


menu "Environment sensors"
config APP_ENV_SENSOR
	bool "Enable environment sensors"
	select ENVIRONMENT_SENSOR
	help
		Enables options for enabling temperature,
		pressure, humidity and gas resistance sensors.

if APP_ENV_SENSOR
rsource "src/sensors/Kconfig.env_sensor"

config APP_TEMP_SENSOR
	bool "Enable temperature sensor"
	select LWM2M_IPSO_TEMP_SENSOR
	select LWM2M_APP_TEMP_SENSOR

config APP_PRESS_SENSOR
	bool "Enable air pressure sensor"
	select LWM2M_IPSO_PRESSURE_SENSOR
	select LWM2M_APP_PRESS_SENSOR

config APP_HUMID_SENSOR
	bool "Enable humidity sensor"
	select LWM2M_IPSO_HUMIDITY_SENSOR
	select LWM2M_APP_HUMID_SENSOR

config APP_GAS_RES_SENSOR
	bool "Enable gas resistance sensor"
	select LWM2M_IPSO_GENERIC_SENSOR
	select LWM2M_APP_GAS_RES_SENSOR
endif # APP_ENV_SENSOR
endmenu # Environment sensor


menu "Accelerometer"
config APP_ACCELEROMETER
	bool "Enable accelerometer"
	select ACCELEROMETER
	select LWM2M_IPSO_ACCELEROMETER
	select LWM2M_APP_ACCELEROMETER

if APP_ACCELEROMETER
	rsource "src/sensors/Kconfig.accelerometer"
endif # APP_ACCELEROMETER
endmenu # Accelerometer

menu "GPS"
config APP_GPS
	bool "Enable GPS"
	select GPS
	select LWM2M_LOCATION_OBJ_SUPPORT

if APP_GPS
config APP_GPS_HOLD_TIME
	int "Minimum time [s] between location data notification messages"
	default 60
	help
	  The minimum time in seconds that notifications can be sent to
	  observers of the Location data.

	rsource "src/sensors/Kconfig.gps"
endif # APP_GPS
endmenu # GPS
endmenu # LwM2M objects

config APP_LWM2M_SERVER
	string "LwM2M server name or IP address"
	help
	  Choose the LwM2M server you wish to connect to.

config APP_PSK
	string "Pre Shared Key"
	help
		Pre Shared Key must be identical to the PSK registered with the
		device on the LwM2M server. Use the hexadeciaml representation.

config APP_HOLD_TIME_RSRP
	int "Minimum time [s] between RSRP notification messages"
	default 60
	help
	  The minimum time in seconds that notifications can be sent to
	  observers of the Connectivity Monitoring data.

config APP_MCUBOOT_FLASH_BUF_SZ
	int "Size of buffer used for flash write operations during MCUboot updates"
	depends on DFU_TARGET_MCUBOOT
	default 512
	help
	  Buffer size must be aligned to the minimal flash write block size.

module = APP
module-dep = LOG
module-str = Log level for sample
source "${ZEPHYR_BASE}/subsys/logging/Kconfig.template.log_config"
endmenu # Application sample


menu "Zephyr Kernel"
source "Kconfig.zephyr"
endmenu # Zephyr Kernel
```

## sample.yaml
```
sample:
	name: nrf LwM2M Sample
tests:
	samples.nrf9160.lwm2m_client:
		build_only: true
		build_on_all: true
		extra_args: OVERLAY_CONFIG=overlay-bootstrap.conf
		platform_allow:
			- nrf9160dk_nrf9160ns
			- thingy91_nrf9160ns
		tags: ci_build
```

## prj.conf
```kconfig
# General config
CONFIG_NEWLIB_LIBC=y
CONFIG_ASSERT=y
CONFIG_REBOOT=y

# Network
CONFIG_NETWORKING=y
CONFIG_NET_NATIVE=n
CONFIG_NET_IPV6=n
CONFIG_NET_IPV4=y
CONFIG_NET_SOCKETS=y
CONFIG_NET_SOCKETS_OFFLOAD=y

# These two settings are needed due to a error in zephyrs lwm2m implementation.
# The error occurs when a multi instance resource is set to have a maximum of one instance.
# When the fix for this error is integrated, which it presumably will be in NCS 1.7,
# these settings can be safely removed. See zephyr PR #36657 for details.
CONFIG_NET_IF_MAX_IPV4_COUNT=2
CONFIG_LWM2M_CONN_MON_APN_MAX=2

# Sensors
CONFIG_I2C=y
CONFIG_SPI=y
CONFIG_SENSOR=y

# UI
CONFIG_UI_LOG_LEVEL_DBG=y

# LwM2M and IPSO
CONFIG_LWM2M=y
CONFIG_LWM2M_COAP_BLOCK_SIZE=512
CONFIG_LWM2M_ENGINE_MAX_OBSERVER=15
CONFIG_LWM2M_ENGINE_MAX_MESSAGES=15
CONFIG_LWM2M_ENGINE_MAX_PENDING=15
CONFIG_LWM2M_ENGINE_MAX_REPLIES=15
CONFIG_LWM2M_ENGINE_DEFAULT_LIFETIME=60
CONFIG_LWM2M_DNS_SUPPORT=y
CONFIG_LWM2M_RW_JSON_SUPPORT=n
CONFIG_LWM2M_SERVER_DEFAULT_PMIN=1
CONFIG_LWM2M_SERVER_DEFAULT_PMAX=300
CONFIG_LWM2M_CLIENT_UTILS=y
CONFIG_LWM2M_CLIENT_UTILS_LOCATION_OBJ_SUPPORT=n
CONFIG_LWM2M_IPSO_SUPPORT=y

# IPSO v1.1
CONFIG_LWM2M_IPSO_TEMP_SENSOR_VERSION_1_1=y
CONFIG_LWM2M_IPSO_HUMIDITY_SENSOR_VERSION_1_1=y
CONFIG_LWM2M_IPSO_GENERIC_SENSOR_VERSION_1_1=y
CONFIG_LWM2M_IPSO_PRESSURE_SENSOR_VERSION_1_1=y
CONFIG_LWM2M_IPSO_PUSH_BUTTON_VERSION_1_1=y
CONFIG_LWM2M_IPSO_ACCELEROMETER_VERSION_1_1=y
CONFIG_LWM2M_IPSO_APP_COLOUR_SENSOR_VERSION_1_1=y

# App
CONFIG_APP_ACCELEROMETER=y
CONFIG_APP_PUSH_BUTTON=y
CONFIG_APP_ENV_SENSOR=y
CONFIG_APP_TEMP_SENSOR=y
CONFIG_APP_PRESS_SENSOR=y
CONFIG_APP_HUMID_SENSOR=y
CONFIG_APP_GAS_RES_SENSOR=y
CONFIG_APP_LIGHT_CONTROL=y
CONFIG_APP_LIGHT_SENSOR=y
CONFIG_APP_GPS=y

# Sensor module
# CONFIG_SENSOR_MODULE=y

# DTLS settings
CONFIG_LWM2M_DTLS_SUPPORT=y
CONFIG_LWM2M_PEER_PORT=5694
# nRF9160 helper libraries
CONFIG_MODEM_KEY_MGMT=y

# Default app to debug logging
CONFIG_LOG=y
CONFIG_APP_LOG_LEVEL_DBG=y

# Expand logging memory to avoid log_strdup() errors
CONFIG_LOG_STRDUP_MAX_STRING=64
CONFIG_LOG_STRDUP_BUF_COUNT=32

# Support HEX style PSK values (double the size + NULL char)
CONFIG_LWM2M_SECURITY_KEY_SIZE=33

# extend CoAP retry timing to 10 seconds for LTE/LTE-M
CONFIG_COAP_INIT_ACK_TIMEOUT_MS=10000

# Enable CoAP extended option length
CONFIG_COAP_EXTENDED_OPTIONS_LEN=y
CONFIG_COAP_EXTENDED_OPTIONS_LEN_VALUE=40

# FOTA
CONFIG_DFU_TARGET=y
CONFIG_BOOTLOADER_MCUBOOT=y
CONFIG_IMG_MANAGER=y
CONFIG_MCUBOOT_IMG_MANAGER=y
CONFIG_IMG_ERASE_PROGRESSIVELY=y
CONFIG_FLASH=y
CONFIG_MPU_ALLOW_FLASH_WRITE=y

# Enable settings storage
CONFIG_SETTINGS=y
CONFIG_FCB=y
CONFIG_SETTINGS_FCB=y

# LTE link control
CONFIG_LTE_LINK_CONTROL=y
CONFIG_LTE_AUTO_INIT_AND_CONNECT=n
CONFIG_LTE_NETWORK_MODE_LTE_M_GPS=y

# Modem library
CONFIG_NRF_MODEM_LIB=y

# Modem info
CONFIG_MODEM_INFO=y
CONFIG_MODEM_INFO_ADD_DATE_TIME=y

# Enable shell
CONFIG_NET_SHELL=y

# Heap and stacks
CONFIG_HEAP_MEM_POOL_SIZE=16384
CONFIG_MAIN_STACK_SIZE=8192
CONFIG_SYSTEM_WORKQUEUE_STACK_SIZE=2048

# Temporarily disable CC310 entropy driver
CONFIG_ENTROPY_CC3XX=n
CONFIG_TEST_RANDOM_GENERATOR=y

# Set LwM2M Server IP address here
CONFIG_APP_LWM2M_SERVER="eu.iot.avsystem.cloud"

# Set PSK here
CONFIG_APP_PSK="6E7266736563726574"

# Trace option.
CONFIG_NRF_MODEM_LIB_TRACE_ENABLED=y

# Event manager
CONFIG_EVENT_MANAGER=y
CONFIG_LINKER_ORPHAN_SECTION_PLACE=y

# Date-Time library
CONFIG_DATE_TIME=y
CONFIG_DATE_TIME_UPDATE_INTERVAL_SECONDS=86400
```

## overlay-bootstrap.conf
```kconfig
CONFIG_LWM2M_PEER_PORT=5694
CONFIG_LWM2M_RD_CLIENT_SUPPORT_BOOTSTRAP=y
```

## overlay-nrf9160dk.conf
```kconfig
## nRF9160DK-specific config settings ##
# Sensors
CONFIG_SENSOR_SIM_ACCEL_WAVE=y
CONFIG_ACCEL_USE_SIM=y
CONFIG_ACCEL_CALIBRATE_ON_STARTUP=n
CONFIG_ENV_SENSOR_USE_SIM=y
CONFIG_LIGHT_SENSOR_USE_SIM=y
CONFIG_LIGHT_SENSOR_LIGHT_MEASUREMENT_MAX_VALUE=300
CONFIG_LIGHT_SENSOR_COLOUR_MEASUREMENT_MAX_VALUE=300

# IPSO
CONFIG_LWM2M_IPSO_LIGHT_CONTROL_INSTANCE_COUNT=4
CONFIG_LWM2M_IPSO_PUSH_BUTTON_INSTANCE_COUNT=2
CONFIG_LWM2M_IPSO_ONOFF_SWITCH_INSTANCE_COUNT=2

# App
CONFIG_APP_ONOFF_SWITCH=y
```

## overlay-sensor_module.conf
```kconfig
CONFIG_SENSOR_MODULE=n
CONFIG_SENSOR_MODULE_TEMP=y
CONFIG_SENSOR_MODULE_TEMP_PERIOD=30
CONFIG_SENSOR_MODULE_TEMP_DELTA_INT=0
CONFIG_SENSOR_MODULE_HUMID=y
CONFIG_SENSOR_MODULE_HUMID_PERIOD=30
CONFIG_SENSOR_MODULE_HUMID_DELTA_INT=0
CONFIG_SENSOR_MODULE_PRESS=y
CONFIG_SENSOR_MODULE_PRESS_PERIOD=30
CONFIG_SENSOR_MODULE_PRESS_DELTA_DEC=0
CONFIG_SENSOR_MODULE_GAS_RES=y
CONFIG_SENSOR_MODULE_GAS_RES_PERIOD=30
CONFIG_SENSOR_MODULE_GAS_RES_DELTA=0
CONFIG_SENSOR_MODULE_ACCEL=y
CONFIG_SENSOR_MODULE_ACCEL_PERIOD=30
CONFIG_SENSOR_MODULE_ACCEL_X_DELTA_INT=0
CONFIG_SENSOR_MODULE_LIGHT=y
CONFIG_SENSOR_MODULE_LIGHT_PERIOD=30
CONFIG_SENSOR_MODULE_LIGHT_DELTA_R=20
CONFIG_SENSOR_MODULE_COLOUR=y
CONFIG_SENSOR_MODULE_COLOUR_PERIOD=30
CONFIG_SENSOR_MODULE_COLOUR_DELTA_R=20
```

## overlay-thingy91.conf
```kconfig
## Thingy:91-specific config settings ##
# UI
CONFIG_UI_LED_USE_PWM=y

# Sensors
CONFIG_BME680=y
CONFIG_ADXL362=y
CONFIG_ADXL362_ACCEL_RANGE_2G=y
CONFIG_BH1749=y
CONFIG_LIGHT_SENSOR_LIGHT_MEASUREMENT_MAX_VALUE=2000
CONFIG_LIGHT_SENSOR_COLOUR_MEASUREMENT_MAX_VALUE=3000

# IPSO v1.1
CONFIG_LWM2M_IPSO_APP_BUZZER_VERSION_1_1=y

# App LwM2M
CONFIG_APP_BUZZER=y
```

## src/main.c
```c
/*
 * Copyright (c) 2019 Nordic Semiconductor ASA
 *
 * SPDX-License-Identifier: LicenseRef-Nordic-5-Clause
 */

#include <zephyr.h>
#include <ctype.h>
#include <drivers/gpio.h>
#include <stdio.h>
#include <net/lwm2m.h>
#include <net/lwm2m_client_utils.h>
#include <net/lwm2m_client_utils_fota.h>
#include <modem/nrf_modem_lib.h>
#include <settings/settings.h>
#include <event_manager.h>
#include <date_time.h>

#include <logging/log.h>
LOG_MODULE_REGISTER(app_lwm2m_client, CONFIG_APP_LOG_LEVEL);

#include <modem/at_cmd.h>
#include <modem/lte_lc.h>

#if defined(CONFIG_LWM2M_DTLS_SUPPORT)
#if defined(CONFIG_MODEM_KEY_MGMT)
#include <modem/modem_key_mgmt.h>
#endif
#endif

#include "lwm2m_client.h"
#include "lwm2m_app_utils.h"
#include "sensor_module.h"
#include "gps_module.h"

#if !defined(CONFIG_LTE_LINK_CONTROL)
#error  "Missing CONFIG_LTE_LINK_CONTROL"
#endif

BUILD_ASSERT(sizeof(CONFIG_APP_LWM2M_SERVER) > 1,
	     "CONFIG_APP_LWM2M_SERVER must be set in prj.conf");

#define APP_BANNER "Run LWM2M client"

#define IMEI_LEN 15
#define ENDPOINT_NAME_LEN (IMEI_LEN + 8)

#define LWM2M_SECURITY_PRE_SHARED_KEY 0
#define LWM2M_SECURITY_RAW_PUBLIC_KEY 1
#define LWM2M_SECURITY_CERTIFICATE 2
#define LWM2M_SECURITY_NO_SEC 3

static uint8_t endpoint_name[ENDPOINT_NAME_LEN + 1];
static uint8_t imei_buf[IMEI_LEN + 5]; /* account for /n/r */
static struct lwm2m_ctx client;

#if defined(CONFIG_LWM2M_DTLS_SUPPORT)
#include "config.h"
#endif /* CONFIG_LWM2M_DTLS_SUPPORT */

static struct k_sem lwm2m_restart;

static void rd_client_event(struct lwm2m_ctx *client, enum lwm2m_rd_client_event client_event);

void client_acknowledge(void)
{
	lwm2m_acknowledge(&client);
}

static int remove_whitespace(char *buf)
{
	size_t i, j = 0, len;

	len = strlen(buf);
	for (i = 0; i < len; i++) {
		if (buf[i] >= 32 && buf[i] <= 126) {
			if (j != i) {
				buf[j] = buf[i];
			}

			j++;
		}
	}

	if (j < len) {
		buf[j] = '\0';
	}

	return 0;
}

static int query_modem(const char *cmd, char *buf, size_t buf_len)
{
	int ret;
	enum at_cmd_state at_state;

	ret = at_cmd_write(cmd, buf, buf_len, &at_state);
	if (ret) {
		LOG_ERR("at_cmd_write [%s] error:%d, at_state: %d", cmd, ret, at_state);
		strncpy(buf, "error", buf_len);
		return ret;
	}

	remove_whitespace(buf);
	return 0;
}

static int lwm2m_setup(void)
{
#if defined(CONFIG_LWM2M_CLIENT_UTILS_DEVICE_OBJ_SUPPORT)
	/* Manufacturer independent */
	lwm2m_init_device();
#endif

	/* Manufacturer dependent */
	/* use IMEI as serial number */
	lwm2m_app_init_device(imei_buf);
	lwm2m_init_security(&client, endpoint_name);

#if defined(CONFIG_LWM2M_CLIENT_UTILS_FIRMWARE_UPDATE_OBJ_SUPPORT)
	lwm2m_init_firmware();
#endif
#if defined(CONFIG_LWM2M_CLIENT_UTILS_CONN_MON_OBJ_SUPPORT)
	lwm2m_init_connmon();
#endif
#if defined(CONFIG_LWM2M_APP_LIGHT_CONTROL)
	lwm2m_init_light_control();
#endif
#if defined(CONFIG_LWM2M_APP_TEMP_SENSOR)
	lwm2m_init_temp_sensor();
#endif
#if defined(CONFIG_LWM2M_APP_PRESS_SENSOR)
	lwm2m_init_press_sensor();
#endif
#if defined(CONFIG_LWM2M_APP_HUMID_SENSOR)
	lwm2m_init_humid_sensor();
#endif
#if defined(CONFIG_LWM2M_APP_GAS_RES_SENSOR)
	lwm2m_init_gas_res_sensor();
#endif
#if defined(CONFIG_LWM2M_APP_BUZZER)
	lwm2m_init_buzzer();
#endif
#if defined(CONFIG_LWM2M_APP_PUSH_BUTTON)
	lwm2m_init_push_button();
#endif
#if defined(CONFIG_LWM2M_APP_ONOFF_SWITCH)
	lwm2m_init_onoff_switch();
#endif
#if defined(CONFIG_LWM2M_APP_ACCELEROMETER)
	lwm2m_init_accel();
#endif
#if defined(CONFIG_LWM2M_APP_LIGHT_SENSOR)
	lwm2m_init_light_sensor();
#endif
#if defined(CONFIG_LWM2M_LOCATION_OBJ_SUPPORT)
	initialise_gps();
#endif
	return 0;
}

int lwm2m_security_index_to_inst_id(int index);

static int find_server_security_instance(void)
{
	char pathstr[10];
	bool bootstrap;
	int i;
	int instance;
	int ret;

	for (i = 0; i < CONFIG_LWM2M_SECURITY_INSTANCE_COUNT; i++) {
		instance = lwm2m_security_index_to_inst_id(i);
		if (instance < 0) {
			LOG_DBG("Empty instance at index %d", i);
			continue;
		}

		snprintk(pathstr, sizeof(pathstr), "0/%d/1", instance);

		ret = lwm2m_engine_get_bool(pathstr, &bootstrap);
		if (ret < 0) {
			LOG_ERR("Error %d: failed to check bootstrap", ret);
			continue;
		}

		if (!bootstrap) {
			LOG_DBG("Security instance found, %d", instance);
			return instance;
		}
	}

	return -1;
}

static int get_security_mode(int instance)
{
	char pathstr[10];
	uint8_t security_mode;
	int ret;

	snprintk(pathstr, sizeof(pathstr), "0/%d/2", instance);

	ret = lwm2m_engine_get_u8(pathstr, &security_mode);
	if (ret < 0) {
		LOG_ERR("Error %d: failed to obtain security mode", ret);
		return -1;
	}

	return security_mode;
}

#if defined(CONFIG_LWM2M_DTLS_SUPPORT)
static void provision_psk(int instance)
{
	char pathstr[10];
	char psk_hex[64];
	int ret;
	uint8_t *identity;
	uint16_t identity_len;
	uint8_t *psk;
	uint16_t psk_len;
	uint8_t flags;

	/* Obtain identity. */
	snprintk(pathstr, sizeof(pathstr), "0/%d/3", instance);

	ret = lwm2m_engine_get_res_data(pathstr, (void **)&identity, &identity_len, &flags);
	if (ret < 0) {
		LOG_ERR("Error %d: failed to obtain client identity", ret);
		return;
	}

	/* Obtain PSK. */
	snprintk(pathstr, sizeof(pathstr), "0/%d/5", instance);

	ret = lwm2m_engine_get_res_data(pathstr, (void **)&psk, &psk_len, &flags);
	if (ret < 0) {
		LOG_ERR("Error %d: failed to obtain PSK", ret);
		return;
	}

	/* Convert PSK to a format accepted by the modem. */
	psk_len = bin2hex(psk, psk_len, psk_hex, sizeof(psk_hex));
	if (psk_len == 0) {
		LOG_ERR("Error %d: PSK is too large to convert", -EOVERFLOW);
		return;
	}

	lwm2m_rd_client_stop(&client, rd_client_event);
	lte_lc_offline();

	ret = modem_key_mgmt_write(client.tls_tag, MODEM_KEY_MGMT_CRED_TYPE_PSK, psk_hex, psk_len);
	if (ret < 0) {
		LOG_ERR("Error %d: setting cred tag %d type %d failed", ret, client.tls_tag,
			MODEM_KEY_MGMT_CRED_TYPE_PSK);
		goto exit;
	}

	ret = modem_key_mgmt_write(client.tls_tag, MODEM_KEY_MGMT_CRED_TYPE_IDENTITY, identity,
				   identity_len);
	if (ret < 0) {
		LOG_ERR("Error %d: setting cred tag %d type %d failed", ret, client.tls_tag,
			MODEM_KEY_MGMT_CRED_TYPE_IDENTITY);
	}

exit:
	lte_lc_connect();
	lwm2m_rd_client_start(&client, endpoint_name, false, rd_client_event);
}
#endif

static void provision_credentials(void)
{
	int security_instance;
	int security_mode;

	security_instance = find_server_security_instance();
	if (security_instance == -1) {
		LOG_ERR("Error %d: no security instance found", -ENODEV);
		return;
	}

	security_mode = get_security_mode(security_instance);
	if (security_mode == -1) {
		return;
	}

	switch (security_mode) {
#if defined(CONFIG_LWM2M_DTLS_SUPPORT)
	case LWM2M_SECURITY_PRE_SHARED_KEY:
		LOG_DBG("PSK mode, provisioning key and identity.");
		client.tls_tag = SERVER_TLS_TAG;
		provision_psk(security_instance);
		break;
#endif

	case LWM2M_SECURITY_NO_SEC:
		LOG_DBG("NoSec mode, no provisioning needed.");
		break;

	default:
		LOG_ERR("Error %d: unsupported security mode", -ENOTSUP);
		break;
	}
}

static void date_time_event_handler(const struct date_time_evt *evt)
{
	switch (evt->type) {
	case DATE_TIME_OBTAINED_MODEM: {
		int64_t time = 0;

		LOG_INF("Obtained date-time from modem");
		date_time_now(&time);
		lwm2m_engine_set_s32(LWM2M_PATH(IPSO_OBJECT_DEVICE_ID, 0, CURRENT_TIME_RID),
				     (int32_t)(time / 1000));
		break;
	}

	case DATE_TIME_OBTAINED_NTP: {
		int64_t time = 0;

		LOG_INF("Obtained date-time from NTP server");
		date_time_now(&time);
		lwm2m_engine_set_s32(LWM2M_PATH(IPSO_OBJECT_DEVICE_ID, 0, CURRENT_TIME_RID),
				     (int32_t)(time / 1000));
		break;
	}

	case DATE_TIME_NOT_OBTAINED:
		LOG_INF("Could not obtain date-time update");
		break;

	default:
		break;
	}
}

static void rd_client_event(struct lwm2m_ctx *client, enum lwm2m_rd_client_event client_event)
{
	switch (client_event) {
	case LWM2M_RD_CLIENT_EVENT_NONE:
		/* do nothing */
		break;

	case LWM2M_RD_CLIENT_EVENT_BOOTSTRAP_REG_FAILURE:
		LOG_DBG("Bootstrap registration failure!");
		break;

	case LWM2M_RD_CLIENT_EVENT_BOOTSTRAP_REG_COMPLETE:
		LOG_DBG("Bootstrap registration complete");
		break;

	case LWM2M_RD_CLIENT_EVENT_BOOTSTRAP_TRANSFER_COMPLETE:
		LOG_DBG("Bootstrap transfer complete");
		LOG_DBG("Boostrap finished, provisioning credentials.");
		provision_credentials();
		break;

	case LWM2M_RD_CLIENT_EVENT_REGISTRATION_FAILURE:
		LOG_DBG("Registration failure!");
		break;

	case LWM2M_RD_CLIENT_EVENT_REGISTRATION_COMPLETE:
		LOG_DBG("Registration complete");
		/* Get current time and date */
		date_time_update_async(date_time_event_handler);
		/* Set lifetime */
		lwm2m_engine_set_u32(LWM2M_PATH(IPSO_OBJECT_SERVER_ID, 2, LIFETIME_RID),
				     CONFIG_LWM2M_ENGINE_DEFAULT_LIFETIME);
#if defined(CONFIG_APP_GPS)
		start_gps_search();
#endif
		break;

	case LWM2M_RD_CLIENT_EVENT_REG_UPDATE_FAILURE:
		LOG_DBG("Registration update failure!");
		break;

	case LWM2M_RD_CLIENT_EVENT_REG_UPDATE_COMPLETE:
		LOG_DBG("Registration update complete");
		break;

	case LWM2M_RD_CLIENT_EVENT_DEREGISTER_FAILURE:
		LOG_DBG("Deregister failure!");
		break;

	case LWM2M_RD_CLIENT_EVENT_DISCONNECT:
		LOG_DBG("Disconnected");
		break;

	case LWM2M_RD_CLIENT_EVENT_QUEUE_MODE_RX_OFF:
		LOG_DBG("Queue mode RX window closed");
		break;

	case LWM2M_RD_CLIENT_EVENT_NETWORK_ERROR:
		LOG_ERR("LwM2M engine reported a network error.");
		k_sem_give(&lwm2m_restart);
		break;
	}
}

static void modem_connect(void)
{
	int ret;

#if defined(CONFIG_LWM2M_QUEUE_MODE_ENABLED)
	ret = lte_lc_psm_req(true);
	if (ret < 0) {
		LOG_ERR("lte_lc_psm_req, error: (%d)", ret);
	} else {
		LOG_INF("PSM mode requested");
	}
#endif

	do {
		LOG_INF("Connecting to LTE network.");
		LOG_INF("This may take several minutes.");

		ret = lte_lc_connect();
		if (ret < 0) {
			LOG_WRN("Failed to establish LTE connection (%d).", ret);
			LOG_WRN("Will retry in a minute.");
			lte_lc_offline();
			k_sleep(K_SECONDS(60));
		} else {
			LOG_INF("Connected to LTE network");
		}
	} while (ret < 0);
}

void main(void)
{
	uint32_t flags = IS_ENABLED(CONFIG_LWM2M_RD_CLIENT_SUPPORT_BOOTSTRAP) ?
				       LWM2M_RD_CLIENT_FLAG_BOOTSTRAP :
				       0;
	int ret;

	LOG_INF(APP_BANNER);

	k_sem_init(&lwm2m_restart, 0, 1);

	ret = event_manager_init();
	if (ret) {
		LOG_ERR("Error %d: unable to init event manager", ret);
		return;
	}

	ret = fota_settings_init();
	if (ret < 0) {
		LOG_ERR("Error %d: unable to init settings", ret);
		return;
	}

	/* Load *all* persistent settings */
	settings_load();

#if defined(CONFIG_LWM2M_FIRMWARE_UPDATE_OBJ_SUPPORT)
	/* Modem FW update needs to be verified before modem is used. */
	lwm2m_verify_modem_fw_update();
#endif

	LOG_INF("Initializing modem.");
	ret = lte_lc_init();
	if (ret < 0) {
		LOG_ERR("Error %d: unable to init modem", ret);
		return;
	}

	/* query IMEI */
	query_modem("AT+CGSN", imei_buf, sizeof(imei_buf));
	/* use IMEI as unique endpoint name */
	snprintf(endpoint_name, sizeof(endpoint_name), "nrf-%s", imei_buf);
	LOG_INF("endpoint: %s", log_strdup(endpoint_name));

	/* Setup LwM2M */
	(void)memset(&client, 0x0, sizeof(client));

	ret = lwm2m_setup();
	if (ret < 0) {
		LOG_ERR("Error %d: failed to setup LWM2M fields", ret);
		return;
	}

	ret = lwm2m_init_image();
	if (ret < 0) {
		LOG_ERR("Error %d: failed to setup image properties", ret);
		return;
	}

#if defined(CONFIG_LWM2M_DTLS_SUPPORT)
	ret = modem_key_mgmt_write(client.tls_tag, MODEM_KEY_MGMT_CRED_TYPE_PSK, client_psk,
				   strlen(client_psk));
	if (ret < 0) {
		LOG_ERR("Error %d: setting cred tag %d type %d failed", ret, client.tls_tag,
			MODEM_KEY_MGMT_CRED_TYPE_PSK);
	}

	ret = modem_key_mgmt_write(client.tls_tag, MODEM_KEY_MGMT_CRED_TYPE_IDENTITY, endpoint_name,
				   strlen(endpoint_name));
	if (ret < 0) {
		LOG_ERR("Error %d: setting cred tag %d type %d failed", ret, client.tls_tag,
			MODEM_KEY_MGMT_CRED_TYPE_IDENTITY);
	}
#endif

	modem_connect();

#if defined(CONFIG_LWM2M_CLIENT_UTILS_CONN_MON_OBJ_SUPPORT)
	ret = lwm2m_update_connmon();
	if (ret < 0) {
		LOG_ERR("Error %d: registering rsrp handler failed", ret);
	}
#endif

#ifdef CONFIG_SENSOR_MODULE
	ret = sensor_module_init();
	if (ret) {
		LOG_ERR("Error %d: could not initialize sensor module", ret);
	}
#endif

	while (true) {
		lwm2m_rd_client_start(&client, endpoint_name, flags, rd_client_event);

		k_sem_take(&lwm2m_restart, K_FOREVER);

		LOG_INF("LwM2M restart requested. The sample will try to"
			" re-establish network connection.");

		/* Stop the LwM2M engine. */
		lwm2m_rd_client_stop(&client, rd_client_event);

		/* Try to reconnect to the network. */
		ret = lte_lc_offline();
		if (ret < 0) {
			LOG_ERR("Error %d: failed to put LTE link in offline state", ret);
		}

		modem_connect();
	}
}
```

## src/config.h
```c
/*
 * Copyright (c) 2020 Nordic Semiconductor ASA
 *
 * SPDX-License-Identifier: LicenseRef-Nordic-5-Clause
 */

#if defined(CONFIG_LWM2M_DTLS_SUPPORT)

#define SERVER_TLS_TAG 35724861
#define BOOTSTRAP_TLS_TAG 35724862

static char client_psk[] = CONFIG_APP_PSK;

#endif /* defined(CONFIG_LWM2M_DTLS_SUPPORT) */
```
